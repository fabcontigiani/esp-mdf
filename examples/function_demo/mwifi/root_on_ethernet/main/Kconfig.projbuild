## examples/function_demo/mwifi/root_on_ethernet/main/Kconfig.projbuild
```kconfig
menu "Example Configuration"

config MESH_ID
    string "Mesh ID"
        default "123456"
        help
            Mesh network identification, Nodes with the same mesh ID can
            communicate with each other.

config MESH_CHANNEL
    int "Mesh network channel"
    range 1 14
    default 13
    help
        Mesh network channel.

config MESH_PASSWORD
    string "Mesh Password"
    default "MESH_PASSWORD"
    help
        Mesh AP password. Password length must be 8 bits smaller than 64 bits,Set to null to not encrypt

config SERVER_IP
    string "Server IP address"
        default "192.168.0.1"
        help
            Server IP address.

config SERVER_PORT
    int "Server port"
        default "8070"
        help
            Server port.
    
    menu "ethernet-config"
    
        choice EXAMPLE_USE_ETHERNET
            prompt "Ethernet Type"
            default EXAMPLE_USE_INTERNAL_ETHERNET if IDF_TARGET_ESP32
            default EXAMPLE_USE_DM9051 if !IDF_TARGET_ESP32
            help
                Select which kind of Ethernet will be used in the example.

            config EXAMPLE_USE_INTERNAL_ETHERNET
                depends on IDF_TARGET_ESP32
                select ETH_USE_ESP32_EMAC
                bool "Internal EMAC"
                help
                    Select internal Ethernet MAC controller.
                    
            config EXAMPLE_USE_DM9051
                bool "DM9051 Module"
                select ETH_USE_SPI_ETHERNET
                select ETH_SPI_ETHERNET_DM9051
                help
                    Select external SPI-Ethernet module (DM9051).

            config EXAMPLE_USE_KSZ8851SNL
                bool "KSZ8851SNL Module"
                select ETH_USE_SPI_ETHERNET
                select ETH_SPI_ETHERNET_KSZ8851SNL
                help
                    Select external SPI-Ethernet module (KSZ8851SNL).

            config EXAMPLE_USE_W5500
                bool "W5500 Module"
                select ETH_USE_SPI_ETHERNET
                select ETH_SPI_ETHERNET_W5500
                help
                    Select external SPI-Ethernet module (W5500).

        endchoice

        if EXAMPLE_USE_INTERNAL_ETHERNET
            choice EXAMPLE_ETH_PHY_MODEL
                prompt "Ethernet PHY Device"
                default EXAMPLE_ETH_PHY_IP101
                help
                    Select the Ethernet PHY device to use in the example.

                config EXAMPLE_ETH_PHY_IP101
                    bool "IP101"
                    help
                        IP101 is a single port 10/100 MII/RMII/TP/Fiber Fast Ethernet Transceiver.
                        Goto http://www.icplus.com.tw/pp-IP101G.html for more information about it.

                config EXAMPLE_ETH_PHY_RTL8201
                    bool "RTL8201/SR8201"
                    help
                        RTL8201F/SR8201F is a single port 10/100Mb Ethernet Transceiver with auto MDIX.
                        Goto http://www.corechip-sz.com/productsview.asp?id=22 for more information about it.
    
                config EXAMPLE_ETH_PHY_LAN87XX
                    bool "LAN87xx"
                    help
                        ESP-IDF v4.4 only supports LAN8720A.
                        Below chips are supported with ESP-IDF v5+:
                        LAN8710A is a small footprint MII/RMII 10/100 Ethernet Transceiver with HP Auto-MDIX and
                            flexPWR® Technology.
                        LAN8720A is a small footprint RMII 10/100 Ethernet Transceiver with HP Auto-MDIX Support.
                        LAN8740A/LAN8741A is a small footprint MII/RMII 10/100 Energy Efficient Ethernet Transceiver
                            with HP Auto-MDIX and flexPWR® Technology.
                        LAN8742A is a small footprint RMII 10/100 Ethernet Transceiver with HP Auto-MDIX and
                            flexPWR® Technology.
                        Goto https://www.microchip.com for more information about them.
    
                config EXAMPLE_ETH_PHY_DP83848
                    bool "DP83848"
                    help
                        DP83848 is a single port 10/100Mb/s Ethernet Physical Layer Transceiver.
                        Goto http://www.ti.com/product/DP83848J for more information about it.
    
                config EXAMPLE_ETH_PHY_KSZ80XX
                    bool "KSZ80xx"
                    help
                        Requires ESP-IDF v5+
                        With the KSZ80xx series, Microchip offers single-chip 10BASE-T/100BASE-TX
                        Ethernet Physical Layer Tranceivers (PHY).
                        The following chips are supported: KSZ8001, KSZ8021, KSZ8031, KSZ8041,
                            KSZ8051, KSZ8061, KSZ8081, KSZ8091
                        Goto https://www.microchip.com for more information about them.
                endchoice

            config EXAMPLE_ETH_MDC_GPIO
                int "SMI MDC GPIO number"
                default 23
                help
                    Set the GPIO number used by SMI MDC.

            config EXAMPLE_ETH_MDIO_GPIO
                int "SMI MDIO GPIO number"
                default 18
                help
                    Set the GPIO number used by SMI MDIO.
        endif

        if EXAMPLE_USE_DM9051
            config EXAMPLE_DM9051_SPI_HOST
                int "SPI Host Number"
                range 0 2
                default 1
                help
                    Set the SPI host used to communicate with the SPI Ethernet Controller.

            config EXAMPLE_DM9051_SCLK_GPIO
                int "SPI SCLK GPIO number"
                range 0 33
                default 19
                help
                    Set the GPIO number used by SPI SCLK.

            config EXAMPLE_DM9051_MOSI_GPIO
                int "SPI MOSI GPIO number"
                range 0 33
                default 23
                help
                    Set the GPIO number used by SPI MOSI.

            config EXAMPLE_DM9051_MISO_GPIO
                int "SPI MISO GPIO number"
                range 0 33
                default 25
                help
                    Set the GPIO number used by SPI MISO.

            config EXAMPLE_DM9051_CS_GPIO
                int "SPI CS GPIO number"
                range 0 33
                default 22
                help
                    Set the GPIO number used by SPI CS.

            config EXAMPLE_DM9051_SPI_CLOCK_MHZ
                int "SPI clock speed (MHz)"
                range 5 80
                default 20
                help
                    Set the clock speed (MHz) of SPI interface.

            config EXAMPLE_DM9051_INT_GPIO
                int "Interrupt GPIO number"
                default 4
                help
                    Set the GPIO number used by DM9051 interrupt.
        endif

        config EXAMPLE_ETH_PHY_RST_GPIO
            int "PHY Reset GPIO number"
            default 5
            help
                Set the GPIO number used to reset PHY chip.
                Set to -1 to disable PHY chip hardware reset.

        config EXAMPLE_ETH_PHY_ADDR
            int "PHY Address"
            range 0 31 if EXAMPLE_USE_INTERNAL_ETHERNET
            range 1 1 if !EXAMPLE_USE_INTERNAL_ETHERNET
            default 1
            help
                Set PHY address according your board schematic.

    
    endmenu

endmenu
```
